## app/boards/shields/dumbpad/Kconfig.default
```kconfig
# Copyright (c) 2022 The ZMK Contributors
# SPDX-License-Identifier: MIT

if SHIELD_DUMBPAD

config ZMK_KEYBOARD_NAME
    default "dumbpad"

endif
```
